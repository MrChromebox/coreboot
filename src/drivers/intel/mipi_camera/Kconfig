## src/drivers/intel/mipi_camera/Kconfig
```kconfig
## SPDX-License-Identifier: GPL-2.0-only

config DRIVERS_INTEL_MIPI_CAMERA
	bool
	depends on HAVE_ACPI_TABLES
	default n
	help
	  MIPI CSI I2C camera SSDT generator. Generates SSDB and PWDB
	  structures which are used by the Intel kernel drivers.

config DRIVERS_INTEL_MIPI_SUPPORTS_PRE_PRODUCTION_SOC
	def_bool n
	help
	  Use this config to provide information to IPU kernel driver
	  if pre-production or production signed IPU FW needs to be loaded.

config MIPI_CAMERA_SINGLE_ACPI_DEVICE
	bool
	depends on DRIVERS_INTEL_MIPI_CAMERA
	default n
	help
	  Generates a single ACPI device for all camera related devices,
	  instead of one for each camera related device. This is the
	  preferred method for Windows and mainline Linux.
```

## src/drivers/intel/oc_mailbox/Kconfig
```kconfig
## SPDX-License-Identifier: GPL-2.0-only

config DRIVERS_INTEL_OC_MAILBOX
	bool
	depends on CPU_INTEL_HASWELL || SOC_INTEL_COMMON_SKYLAKE_BASE || SOC_INTEL_CANNONLAKE_BASE
	help
	  Provides access to the Intel's OC Mailbox MSR (0x150).
	  Supports 4th-10th generation Intel Core CPUs (Haswell-Cometlake).

if DRIVERS_INTEL_OC_MAILBOX

config INTEL_OC_MAILBOX_ENABLE_UNDERVOLTING
	bool "Enable undervolting via OC mailbox"
	help
	  Program per-plane voltage offsets via OC Mailbox MSR.
	  When enabled, coreboot can apply per-domain undervolt settings at boot
	  (core/GT/cache/SA and I/O planes, depending on CPU generation). Settings
	  are exposed as runtime options and written using OC_MAILBOX commands.

config HAS_DIGITAL_IO_POWER_DOMAIN
	bool
	default y if CPU_INTEL_HASWELL
	default n

config NUM_OC_MAILBOX_PLANES
	int
	default 6 if HAS_DIGITAL_IO_POWER_DOMAIN
	default 5

endif
```

## src/mainboard/framework/common/Kconfig
```kconfig
## SPDX-License-Identifier: GPL-2.0-or-later

if VENDOR_FRAMEWORK

config MB_COMMON_DIR
	string
	default "framework/common" if EC_GOOGLE_CHROMEEC

config EDK2_BOOTSPLASH_FILE
	default "src/mainboard/framework/common/logo.png"

endif # VENDOR_FRAMEWORK
```

## src/mainboard/google/Kconfig
```kconfig
## SPDX-License-Identifier: GPL-2.0-only

if VENDOR_GOOGLE

choice
	prompt "Mainboard model"

source "src/mainboard/google/*/Kconfig.name"

endchoice

source "src/mainboard/google/*/Kconfig"

config MAINBOARD_VENDOR
	default "Google"

if HAVE_POWER_STATE_AFTER_FAILURE

config CHROMEEC_AFTER_G3_STATE
	bool "Enable configuring ChromeEC After G3 State with CFR at boot"
	default n
	depends on EC_GOOGLE_CHROMEEC
	depends on DRIVERS_OPTION_CFR_ENABLED
	help
	  Enable configuring ChromeEC After G3 State with CFR at boot via host
	  command, otherwise ChromeEC default compiled after G3 behavior
	  (usually "Previous State") will override coreboot after G3
	  configuration.

	  After G3 State is updated from existing coreboot CFR:
	    "Restore AC power after loss"

	  Only useful for boards with dedicated 3V coin battery to sustain
	  bbram, and only for EC images compiled with
	  CONFIG_POWER_BUTTON_INIT_IDLE, as this ensures that OFF bbram reset
	  flags are retained.

	  This option has no effect if ChromeEC running image does not support
	  custom host command EC_CMD_AFTER_G3_STATE.

endif # HAVE_POWER_STATE_AFTER_FAILURE

endif # VENDOR_GOOGLE
```
