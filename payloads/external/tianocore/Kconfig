## payloads/external/tianocore/Kconfig
```kconfig
if PAYLOAD_TIANOCORE

config PAYLOAD_FILE
	string "Tianocore binary"
	default "payloads/external/tianocore/tianocore/Build/UEFIPAYLOAD.fd"
	help
	  The result of a corebootPkg build

choice
	prompt "Tianocore version"
	default TIANOCORE_STABLE

config TIANOCORE_STABLE
	bool "stable"
	help
	  Stable TianoCore version

config TIANOCORE_MASTER
	bool "master"
	help
	  Newest Tianocore version

config TIANOCORE_REVISION
	bool "git revision"
	help
	  Select this option if you have a specific commit or branch
	  that you want to use as the revision from which to
	  build Tianocore.

	  You will be able to specify the name of a branch or a commit id
	  later.

endchoice

config TIANOCORE_REVISION_ID
	string "Insert a commit's SHA-1 or a branch name"
	depends on TIANOCORE_REVISION
	default "origin/master"
	help
	   The commit's SHA-1 or branch name of the revision to use.

config TIANOCORE_TARGET_IA32
	bool "Restrict Tianocore target architecture to IA32"
	help
	  By default, the Tianocore coreboot Payload Package binary will be
	  built for both X64 and IA32 architectures.  By selecting this option,
	  the target architecture can be restricted to only IA32.

config TIANOCORE_DEBUG
	bool "Generate Tianocore debug build"
	help
	  Generate a debug build instead of a release build.

config TIANOCORE_GOP_DRIVER
	bool "Add a GOP driver to the Tianocore build"
	depends on ADD_VBT_DATA_FILE || ADD_GMA_VBT_DATA_FILE

config TIANOCORE_GOP_FILE
	string "GOP driver file"
	depends on TIANOCORE_GOP_DRIVER
	default "IntelGopDriver.efi"
endif
```

## site-local/Kconfig
```kconfig
#
# MrChromebox Kconfig overrides
#
# Consolidates overrides here vs in individual board configs or via editing source directly
#

# Enable the ME HECI device for HSW/BDW devices
config DISABLE_ME_PCI
	default n

#Enable the ME HECI for Intel common SOCs
config DISABLE_HECI1_AT_PRE_BOOT
	default n

# No need to output POST codes
config NO_POST
	default y

# Add VPD to FMAP by default
config VPD
	default y

# Read serial from VPD if used
config SMBIOS_SERIAL_FROM_VPD
	depends on VPD && GENERATE_SMBIOS_TABLES
	default y if !DRIVERS_GENERIC_CBFS_SERIAL && !VENDOR_EMULATION

# Enables WDT on fizz/puff boards
config USE_PM_ACPI_TIMER
	default y if BOARD_GOOGLE_BASEBOARD_FIZZ || BOARD_GOOGLE_BASEBOARD_PUFF

# Fixes grub booting - need to check if still needed
#config USE_LEGACY_8254_TIMER
#	default y

# GLK FSP overrides
config FSP_HEADER_PATH
	default "src/vendorcode/intel/fsp/fsp2_0/geminilake/2.2.3.1" if SOC_INTEL_GEMINILAKE

config FSP_M_FILE
	default "3rdparty/blobs/soc/intel/glk/fsp/release/Fsp_M.fd" if SOC_INTEL_GEMINILAKE

config FSP_S_FILE
	default "3rdparty/blobs/soc/intel/glk/fsp/release/Fsp_S.fd" if SOC_INTEL_GEMINILAKE

# PCIe hotplug defaults
config PCIEXP_HOTPLUG_PREFETCH_MEM
	default 0x100000000

config PCIEXP_HOTPLUG_IO
	default 0x6000

# edk2 payload options

config EDK2_TAG_OR_REV
	default "origin/uefipayload_202309" if EDK2_REPO_MRCHROMEBOX

config EDK2_BOOT_MANAGER_ESCAPE
	default y

config EDK2_FOLLOW_BGRT_SPEC
	default y

config EDK2_FULL_SCREEN_SETUP
	default n

# Disable serial output
config CONSOLE_SERIAL
	default n

# Ensure CBFS large enough for edk2
config CBFS_SIZE
	default 0x300000 if COREBOOT_ROMSIZE_KB_8192
	default 0x450000 if COREBOOT_ROMSIZE_KB_16384 || COREBOOT_ROMSIZE_KB_32768

# Disable CBFS Metadata cache for PCO
config NO_CBFS_MCACHE
	default y if SOC_AMD_PICASSO

config EDK2_GOP_FILE
	depends on EDK2_GOP_DRIVER
	default "3rdparty/blobs/soc/intel/bdw/IntelGopDriver.efi" if NORTHBRIDGE_INTEL_HASWELL || SOC_INTEL_BROADWELL
	default "3rdparty/blobs/soc/intel/byt/IntelGopDriver.efi" if SOC_INTEL_BAYTRAIL
	default "3rdparty/blobs/soc/intel/bsw/IntelGopDriver.efi" if SOC_INTEL_BRASWELL
	default "3rdparty/blobs/soc/intel/kbl/IntelGopDriver.efi" if SOC_INTEL_SKYLAKE || SOC_INTEL_KABYLAKE
	default "3rdparty/blobs/soc/intel/glk/IntelGopDriver.efi" if SOC_INTEL_GEMINILAKE
	default "3rdparty/blobs/soc/intel/apl/IntelGopDriver.efi" if SOC_INTEL_APOLLOLAKE
	default "3rdparty/blobs/soc/intel/cml/IntelGopDriver.efi" if SOC_INTEL_COMETLAKE || SOC_INTEL_WHISKEYLAKE
	default "3rdparty/blobs/soc/intel/tgl/IntelGopDriver.efi" if SOC_INTEL_TIGERLAKE
	default "IntelGopDriver.efi"
```

## src/drivers/vpd/Kconfig
```kconfig
##
##
## SPDX-License-Identifier: GPL-2.0-only

config VPD
	bool "Support for Vital Product Data tables"
	default n
	help
	  Enable support for flash based vital product data.

config SMBIOS_SERIAL_FROM_VPD
	bool "Load device serial from VPD"
	depends on VPD && GENERATE_SMBIOS_TABLES
	default y
```

## src/mainboard/google/auron/Kconfig
```kconfig
config BOARD_GOOGLE_AURON # dummy option to be selected by variant boards
	def_bool n

if BOARD_GOOGLE_AURON

config BOARD_SPECIFIC_OPTIONS # dummy
	def_bool y
	select SYSTEM_TYPE_LAPTOP
	select SOC_INTEL_BROADWELL
	select BOARD_ROMSIZE_KB_8192
	select EC_GOOGLE_CHROMEEC
	select HAVE_ACPI_TABLES
	select HAVE_OPTION_TABLE
	select HAVE_ACPI_RESUME
	select HAVE_SMI_HANDLER
	select MAINBOARD_HAS_CHROMEOS
	select MAINBOARD_HAS_LPC_TPM
	select INTEL_INT15
	select INTEL_GMA_ACPI

config CHROMEOS
	select CHROMEOS_RAMOOPS_DYNAMIC
	select EC_GOOGLE_CHROMEEC_SWITCHES
	select EC_SOFTWARE_SYNC
	select LID_SWITCH
	select VBOOT_VBNV_CMOS
	select VIRTUAL_DEV_SWITCH

config MAINBOARD_DIR
	string
	default google/auron

config MAINBOARD_PART_NUMBER
	string
	default "Auron"

config IRQ_SLOT_COUNT
	int
	default 18

config MAX_CPUS
	int
	default 8

config VGA_BIOS_FILE
	string
	default "pci8086,0166.rom"

config HAVE_IFD_BIN
	bool
	default n

config HAVE_ME_BIN
	bool
	default n

config MAINBOARD_FAMILY
	string
	depends on GENERATE_SMBIOS_TABLES
	default "Google_Auron"

config EC_GOOGLE_CHROMEEC_BOARDNAME
	string
	default "auron"

config GBB_HWID
	string
	depends on CHROMEOS
	default "PAINE TEST A-A 8843" if BOARD_GOOGLE_AURON_PAINE
	default "YUNA TEST A-A 3347" if BOARD_GOOGLE_AURON_YUNA

config DEVICETREE
	string
	default "devicetree.paine.cb" if BOARD_GOOGLE_AURON_PAINE
	default "devicetree.yuna.cb" if BOARD_GOOGLE_AURON_YUNA

endif
```

## src/mainboard/google/auron/Kconfig.name
```kconfig
config BOARD_GOOGLE_AURON_PAINE
	bool "Auron_Paine"
	select BOARD_GOOGLE_AURON

config BOARD_GOOGLE_AURON_YUNA
	bool "Auron_Yuna"
	select BOARD_GOOGLE_AURON
```

## src/mainboard/google/candy/Kconfig
```kconfig
if BOARD_GOOGLE_CANDY

config BOARD_SPECIFIC_OPTIONS
	def_bool y
	select SOC_INTEL_BAYTRAIL
	select EC_GOOGLE_CHROMEEC
	select ENABLE_BUILTIN_COM1
	select BOARD_ROMSIZE_KB_8192
	select HAVE_ACPI_TABLES
	select HAVE_OPTION_TABLE
	select HAVE_ACPI_RESUME
	select MAINBOARD_HAS_CHROMEOS
	select MAINBOARD_HAS_LPC_TPM

config CHROMEOS
	select EC_SOFTWARE_SYNC
	select LID_SWITCH
	select VBOOT_VBNV_CMOS
	select VIRTUAL_DEV_SWITCH

config MAINBOARD_DIR
	string
	default google/candy

config MAINBOARD_PART_NUMBER
	string
	default "Candy"

config VGA_BIOS_FILE
	string
	default "pci8086,0f31.rom"

config HAVE_IFD_BIN
	bool
	default n

config HAVE_ME_BIN
	bool
	default n

config EC_GOOGLE_CHROMEEC_BOARDNAME
	string
	default ""

config GBB_HWID
	string
	depends on CHROMEOS
	default "CANDY TEST A-A 1345"

endif # BOARD_GOOGLE_CANDY
```

## src/mainboard/google/edgar/Kconfig
```kconfig
if BOARD_GOOGLE_EDGAR

config BOARD_SPECIFIC_OPTIONS
	def_bool y
	select BOARD_ROMSIZE_KB_8192
	select EC_GOOGLE_CHROMEEC
	select EC_GOOGLE_CHROMEEC_MEC
	select EC_GOOGLE_CHROMEEC_ACPI_MEMMAP
	select ENABLE_BUILTIN_COM1
	select HAVE_ACPI_RESUME
	select HAVE_ACPI_TABLES
	select HAVE_OPTION_TABLE
	select MAINBOARD_HAS_CHROMEOS
	select MAINBOARD_HAS_LPC_TPM
	select SOC_INTEL_BRASWELL
	select PCIEXP_L1_SUB_STATE

config VBOOT
	select EC_GOOGLE_CHROMEEC_SWITCHES
	select VBOOT_LID_SWITCH
	select VBOOT_VBNV_CMOS

config DYNAMIC_VNN_SUPPORT
	bool "Enables support for Dynamic VNN"
	default n
config MAINBOARD_DIR
	string
	default google/edgar
config MAINBOARD_PART_NUMBER
	string
	default "Edgar"
config MAINBOARD_FAMILY
	string
	default "Intel_Strago"

if !CONFIG_RUN_FSP_GOP
config VGA_BIOS_FILE
	string
	default "3rdparty/blobs/mainboard/google/edgar/vgabios.bin"
config VGA_BIOS_ID
	string
	default "8086,22b1" if C0_DISP_SUPPORT
endif
endif # BOARD_GOOGLE_EDGAR
```

## src/mainboard/google/leon/Kconfig
```kconfig
if BOARD_GOOGLE_LEON

config BOARD_SPECIFIC_OPTIONS # dummy
	def_bool y
	select SYSTEM_TYPE_LAPTOP
	select CPU_INTEL_HASWELL
	select NORTHBRIDGE_INTEL_HASWELL
	select SOUTHBRIDGE_INTEL_LYNXPOINT
	select INTEL_LYNXPOINT_LP
	select BOARD_ROMSIZE_KB_8192
	select EC_GOOGLE_CHROMEEC
	select HAVE_ACPI_TABLES
	select HAVE_OPTION_TABLE
	select HAVE_ACPI_RESUME
	select MMCONF_SUPPORT
	select HAVE_SMI_HANDLER
	select MAINBOARD_HAS_CHROMEOS
	select MAINBOARD_HAS_LPC_TPM
	select INTEL_INT15
	select DRIVERS_I2C_RTD2132

config CHROMEOS
	select EC_SOFTWARE_SYNC
	select LID_SWITCH
	select VBOOT_VBNV_CMOS
	select VIRTUAL_DEV_SWITCH

config MAINBOARD_DIR
	string
	default google/leon

config MAINBOARD_PART_NUMBER
	string
	default "Leon"

config MMCONF_BASE_ADDRESS
	hex
	default 0xf0000000

config MAX_CPUS
	int
	default 8

config VGA_BIOS_FILE
	string
	default "pci8086,0166.rom"

config HAVE_IFD_BIN
	bool
	default n

config HAVE_ME_BIN
	bool
	default n

config GBB_HWID
	string
	depends on CHROMEOS
	default "X86 LEON TEST 5181"
endif
```

## src/mainboard/google/sentry/Kconfig
```kconfig
if BOARD_GOOGLE_SENTRY

config BOARD_SPECIFIC_OPTIONS # dummy
	def_bool y
	select BOARD_ROMSIZE_KB_16384
	select DRIVERS_GENERIC_MAX98357A
	select DRIVERS_I2C_GENERIC
	select DRIVERS_I2C_NAU8825
	select EC_GOOGLE_CHROMEEC
	select EC_GOOGLE_CHROMEEC_ACPI_MEMMAP
	select EC_GOOGLE_CHROMEEC_BOARDID
	select EC_GOOGLE_CHROMEEC_LPC
	select EC_GOOGLE_CHROMEEC_MEC
	select EC_GOOGLE_CHROMEEC_PD
	select HAVE_ACPI_RESUME
	select HAVE_ACPI_TABLES
	select HAVE_OPTION_TABLE
	select HAVE_SMI_HANDLER
	select MAINBOARD_HAS_CHROMEOS
	select MAINBOARD_HAS_LPC_TPM
	select SOC_INTEL_SKYLAKE
	select INTEL_GMA_ACPI

config VBOOT
	select EC_GOOGLE_CHROMEEC_SWITCHES
	select VBOOT_LID_SWITCH

config IRQ_SLOT_COUNT
	int
	default 18

config MAINBOARD_DIR
	string
	default "google/sentry"

config MAINBOARD_PART_NUMBER
	string
	default "Sentry"

config MAINBOARD_FAMILY
	string
	default "Google_Glados"

config MAX_CPUS
	int
	default 8

config TPM_PIRQ
	hex
	default 0x18  # GPP_E0_IRQ

config INCLUDE_NHLT_BLOBS
	bool "Include blobs for audio."
	select NHLT_DMIC_2CH
	select NHLT_DMIC_4CH
	select NHLT_MAX98357
	select NHLT_NAU88L25
	select NHLT_SSM4567

config EC_GOOGLE_CHROMEEC_BOARDNAME
	string
	default ""

config EC_GOOGLE_CHROMEEC_PD_BOARDNAME
	string
	default ""

config GBB_HWID
	string
	depends on CHROMEOS
	default "SENTRY TEST 6297"
endif
```
